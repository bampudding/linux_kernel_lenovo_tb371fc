## drivers/input/fingerprint/Kconfig
```kconfig
config GOODIX_FINGERPRINT
	tristate "generic goodix fingerprint driver"
	depends on INPUT_FINGERPRINT
	default y
	help
	add support for goodix fingerprint driver.
```
